## 1470_Firmware_Source/buildroot-patches/packages/Config.in
```kconfig
comment "Natively compiled pre-built packages"
source "package/native-samba/Config.in"
source "package/perl/Config.in"
source "package/perl-modules/Config.in"
source "package/ntfs-progs/Config.in"
source "package/pvconnect/Config.in"

comment "Local Oxsemi packages"
source "package/bonnie/Config.in"
source "package/user-if/Config.in"
source "package/xdelta3/Config.in"
source "package/parted/Config.in"

endmenu
```

## 1470_Firmware_Source/buildroot-patches/packages/bonnie/Config.in
```kconfig
config BR2_PACKAGE_BONNIE
	bool "bonnie"
	default n
	help
        Disk performance tool
        
```

## 1470_Firmware_Source/buildroot-patches/packages/native-samba/Config.in
```kconfig
config BR2_PACKAGE_NATIVE_SAMBA
	bool "Natively compiled pre-built samba"
    default y
	help
		Pre-compiled binary SAMBA installation
	
```

## 1470_Firmware_Source/buildroot-patches/packages/ntfs-progs/Config.in
```kconfig
config BR2_PACKAGE_NTFS-PROGS
	bool "Natively compiled pre-built ntfs utilities"
    default y
#    depends on BR2_arm926t
	help
		Pre-compiled binary ntfs-progs installation
	
```

## 1470_Firmware_Source/buildroot-patches/packages/parted/Config.in
```kconfig
config BR2_PACKAGE_PARTED
	bool "parted"
	default n
	help
		GNU parted
		http://ftp.gnu.org/gnu/parted
```

## 1470_Firmware_Source/buildroot-patches/packages/perl-modules/Config.in
```kconfig
config BR2_PACKAGE_PERL_MODULES
	bool "Natively compiled pre-built perl modules"
    default y
    depends on BR2_PACKAGE_PERL
	help
		Pre-compiled binary perl modules installation containing the perl modules needed for the user interface.
	
```

## 1470_Firmware_Source/buildroot-patches/packages/perl/Config.in
```kconfig
config BR2_PACKAGE_PERL
	bool "Natively compiled pre-built perl"
    default y
	help
		Pre-compiled binary perl installation
	
```

## 1470_Firmware_Source/buildroot-patches/packages/pvconnect/Config.in
```kconfig
config BR2_PACKAGE_PVCONNECT
	bool "Natively compiled pre-built pvconnect"
    default n
    depends on BR2_arm926t
	help
		Pre-compiled binary PVConnect installation 
```

## 1470_Firmware_Source/buildroot-patches/packages/user-if/Config.in
```kconfig
config BR2_PACKAGE_USERIF
	bool "web user interface"
	default y
	depends on BR2_PACKAGE_SAMBA && BR2_PACKAGE_PERL && BR2_PACKAGE_PERL_MODULES
    help
		The user interface. Allows client control of NAS system through
		a web browser.
```

## 1470_Firmware_Source/buildroot-patches/packages/xdelta3/Config.in
```kconfig
config BR2_PACKAGE_XDELTA3
	bool "xdelta3 patching tools"
	default y
	depends on BR2_arm926t
    help
		The xdelta3 patch tools. Allows incremental update of binary files.
```

## 1470_Firmware_Source/buildroot-patches/target/device/Oxsemi/Config.in
```kconfig
menuconfig BR2_TARGET_OXSEMI
	bool "Oxford Semiconductor Device Support"
	depends on BR2_arm
	default n

if BR2_TARGET_OXSEMI
source "target/device/Oxsemi/OX810_Config.in"
source "target/device/Oxsemi/OX820_Config.in"

config BR2_BOARD_NAME
        string
        default "OX810_SE"	if	BR2_TARGET_OX810_SE
        default "OX810_DSE"	if	BR2_TARGET_OX810_DSE
        default "OX820_DSE"	if	BR2_TARGET_OX820_DSE

config BR2_OXSEMI_PATH
	string
	default "target/device/Oxsemi"

config BR2_BOARD_PATH
        string
        default "$(BR2_OXSEMI_PATH)/$(BR2_BOARD_NAME)"

endif
```
